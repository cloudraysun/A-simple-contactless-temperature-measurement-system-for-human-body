//==================================================================================================
//  文件名称: MAIN.C
//  文件功能: MAIN-主函数文件
//  文件说明: 无
//  文件类型: Application-应用程序代码
//--------------------------------------------------------------------------------------------------
//  硬件平台: STM32F407xxxx系列
//            STM32F407VET6
//            STM32F407VGT6
//            STM32F407IET6
//            STM32F407IGT6
//            STM32F407ZET6
//            STM32F407ZGT6
//  软件平台: IAR For ARM V6.60/V8.30
//            KEIL MDK v5.25
//--------------------------------------------------------------------------------------------------
//  开发组织: 大小林生
//  开发作者: 大小林生
//  官方网站: 无
//  官方商城: 无
//  微信平台: 无
//  产品链接: 无
//  版权信息: 文件的内容版权为大小林生拥有，使用时请注明版权出处！
//==================================================================================================

//--------------------------------------------------------------------------------------------------
//  包含的头文件    |   0   |   1   |   2   |   3   |   4   |   5   |   6   |   7   |   8   |   9   
//--------------------------------------------------------------------------------------------------
#include"MAIN.H"                                    // 包含全局头文件

//--------------------------------------------------------------------------------------------------
//  宏自定义声明    |   0   |   1   |   2   |   3   |   4   |   5   |   6   |   7   |   8   |   9   
//--------------------------------------------------------------------------------------------------

//--------------------------------------------------------------------------------------------------
//  定义引用变量    |   0   |   1   |   2   |   3   |   4   |   5   |   6   |   7   |   8   |   9   
//--------------------------------------------------------------------------------------------------

//--------------------------------------------------------------------------------------------------
//  硬件端口定义    |   0   |   1   |   2   |   3   |   4   |   5   |   6   |   7   |   8   |   9   
//--------------------------------------------------------------------------------------------------

//--------------------------------------------------------------------------------------------------
//  引用函数声明    |   0   |   1   |   2   |   3   |   4   |   5   |   6   |   7   |   8   |   9   
//--------------------------------------------------------------------------------------------------

//==================================================================================================
//  实现功能: 主函数
//  函数说明: 
//  函数备注: 
//--------------------------------------------------------------------------------------------------
//  |   -   |   -   |   0   |   1   |   2   |   3   |   4   |   5   |   6   |   7   |   8   |   9   
//==================================================================================================
float Temperature;//测试温度
float UP_Limit;//温度阈值
unsigned int Mode;//阈值模式
unsigned time;//时间
void main(void)
{
    //----------------------------------------------------------------------------------------------
    // 禁止 全局中断
    //----------------------------------------------------------------------------------------------
    DisableInterrupts; 
   
    RCC_Configure();                                // RCC 预配置
    DELAY_Configure();                              // DEALAY 预配置 
    GPIO_Configure();                               // GPIO 预配置
    TIME_Configure();                               // TIME 预配置
    SPI_Configure();
    NVIC_Configure();                               // NVIC 预配置
    USART_Configure();
    LEDx4_Init();                                   // LEDx4 初始化
    TFT_Init();                                     // TFT 初始化
    TFT_Clear( TFT_White);
    
    UP_Limit=37.00;
    Mode=0;
    EnableInterrupts;// 允许全局中断
    
    //中断为TIM4
    while(1)
    {
        LEDx4_SetState(LEDx4c2, 0); //红外线
        Temperature=Read_Temp();
        if(KEY_Set_GetValue())
            Mode = ~Mode        ;
        if(Mode==0)//人体模式，加2度
        {
            TFT_ShowString_16x16(90,0,"BODY",TFT_Blue1,TFT_White);   
            Temperature += 2;  //温度补偿
        }
        else//物体表面温度模式
        {
            TFT_ShowString_16x16(90,0,"OBJ",TFT_Blue1,TFT_White);    
        }
        
        TFT_ShowString_16x16(0,0,"Temperature",TFT_Black,TFT_White); 
        TFT_ShowNumber_Float_05x08(0,30,Temperature,2,2,TFT_Black,TFT_White);
        
        if(KEYx4_1_GetValue())//加大
            UP_Limit = UP_Limit+0.01;
        else if(KEYx4_2_GetValue())
            UP_Limit = UP_Limit-0.01;
        else if(KEYx4_3_GetValue())
            UP_Limit = UP_Limit+1;
        else if(KEYx4_4_GetValue())
            UP_Limit = UP_Limit-1;

        
        if(UP_Limit<30.00)
        {
            UP_Limit=30.00;
        }
        if(UP_Limit>46.00)
        {
            UP_Limit=46.00;   
        }
        
        TFT_ShowString_16x16(0,50,"UP_Limit",TFT_Black,TFT_White); 
        TFT_ShowNumber_Float_05x08(0,80,UP_Limit,2,2,TFT_Black,TFT_White);
        
        if(Temperature<UP_Limit)
        {
            LEDx4_SetState(LEDx4c1, 0);

            TFT_ShowString_16x16(20,120,"        ",TFT_Red,TFT_White);     
        }
        else
        {           
            LEDx4_SetState(LEDx4c1, 1); //蜂鸣器
            TFT_ShowString_16x16(20,120,"Waring!",TFT_Red,TFT_White);
        }
        
        DELAY_nMS(100);
        
        if(KEY_Check_GetValue())
        {
            USART_SendChar(USARTx2,'C');//存储式录入人脸
        }     
        else if(KEY_Reset_GetValue())
        {
            USART_SendChar(USARTx2,'A');//临时存储录入人脸
        }
        else if(KEY_Switch_GetValue())
        {
            USART_SendChar(USARTx2,'S');//切换模型，硬件重启
        }
    }
}
